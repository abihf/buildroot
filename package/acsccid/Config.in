## package/acsccid/Config.in
```kconfig
config BR2_PACKAGE_ACSCCID
	bool "acsccid"
	select BR2_PACKAGE_PCSC_LITE
	select BR2_PACKAGE_LIBUSB
	depends on BR2_TOOLCHAIN_HAS_THREADS # libusb
	depends on BR2_USE_MMU # pcsc-lite
	help
	  PC/SC driver for ACS CCID smart card readers.

	  http://acsccid.sourceforge.net/

comment "acsccid needs a toolchain w/ threads"
	depends on BR2_USE_MMU
	depends on !BR2_TOOLCHAIN_HAS_THREADS
```

## package/libfprint/Config.in
```kconfig
config BR2_PACKAGE_LIBFPRINT
	bool "libfprint"
	select BR2_PACKAGE_LIBUSB
	select BR2_PACKAGE_LIBNSS
	select BR2_PACKAGE_GDK_PIXBUF
	depends on BR2_TOOLCHAIN_HAS_THREADS
	depends on BR2_USE_MMU # fork()
	help
	  Open source software library designed to make it easy for 
	  application developers to add support for consumer fingerprint 
	  readers to their software.

	  http://www.freedesktop.org/wiki/Software/fprint/libfprint/


comment "pcsc-lite needs a toolchain w/ threads"
	depends on BR2_USE_MMU
	depends on !BR2_TOOLCHAIN_HAS_THREADS
```

## package/python-gevent/Config.in
```kconfig
config BR2_PACKAGE_PYTHON_GEVENT
	bool "python-gevent"
	depends on BR2_PACKAGE_PYTHON
	select BR2_PACKAGE_PYTHON_GREENLET 
	select BR2_PACKAGE_LIBEVs
	select BR2_PACKAGE_C_ARES
	help
	  gevent is a coroutine-based Python networking library that uses greenlet to provide a high-level synchronous API on top of the libev event loop.

	  http://www.gevent.org/
```

## package/python-pyscard/Config.in
```kconfig
config BR2_PACKAGE_PYTHON_PYSCARD
	bool "python-pyscard"
	depends on BR2_PACKAGE_PYTHON
	select BR2_PACKAGE_PCSC_LITE
	help
	  pyscard is a python module adding smart cards support (PC/SC) to python.

	  http://pyscard.sourceforge.net/
```
